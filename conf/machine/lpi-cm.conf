## conf/machine/lpi-cm.conf
```bitbake
#@TYPE: Machine
#@NAME: lpi-cm
#@DESCRIPTION: ClearTex LPI-CM

require include/rk3328.inc

MACHINE_FEATURES += "usbhost serial"

UBOOT_MACHINE = "lpi-cm-rk3328_defconfig"
KERNEL_DEVICETREE = "rockchip/rk3328-lpi-cm.dtb"

KBUILD_DEFCONFIG = "defconfig"
```
